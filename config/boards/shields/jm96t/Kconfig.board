## config/boards/shields/jm96t/Kconfig.board
```kconfig
# Copyright (c) 2021 Nick Winans
# SPDX-License-Identifier: MIT

config BOARD_JM96T
    bool "jm96t"
    depends on SOC_NRF52840_QIAA
```

## config/boards/shields/jm96t/Kconfig.shield
```kconfig
# Copyright (c) 2020 Pete Johanson
# SPDX-License-Identifier: MIT

config JM96T
	def_bool $(shields_list_contains,jm96t)
```

## config/west.yml
```yaml
manifest:
  remotes:
    - name: zmkfirmware
      url-base: https://github.com/4pplet
  projects:
    - name: zmk
      remote: zmkfirmware
      revision: main
      import: app/west.yml
  self:
    path: config
```
